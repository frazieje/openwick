## boards/sparkfun/pro_nrf52840_mini/board.yml
```yaml
board:
  name: sparkfun_pro_nrf52840_mini
  full_name: SparkFun Pro nRF52840 Mini
  vendor: sparkfun
  socs:
    - name: nrf52840
      variants:
        - name: uf2
```

## boards/sparkfun/pro_nrf52840_mini/sparkfun_pro_nrf52840_mini_defconfig
```kconfig
# SPDX-License-Identifier: Apache-2.0

CONFIG_ARM_MPU=y
CONFIG_HW_STACK_PROTECTION=y

# Enable GPIO
CONFIG_GPIO=y

# Enable UART driver and console
CONFIG_SERIAL=y
CONFIG_CONSOLE=y
CONFIG_UART_CONSOLE=y
```
